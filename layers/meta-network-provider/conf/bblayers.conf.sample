## layers/meta-network-provider/conf/bblayers.conf.sample
```bitbake
LCONF_VERSION = "7"

BBPATH = "${TOPDIR}"
BBFILES ?= ""

BBLAYERS ?= " \
  ##OEROOT##/meta \
  ##OEROOT##/../meta-openembedded/meta-python \
  ##OEROOT##/../meta-openembedded/meta-networking \
  ##OEROOT##/../meta-openembedded/meta-oe \
  ##OEROOT##/../meta-raspberrypi \
  ##OEROOT##/../meta-network-provider \
"
```

## layers/meta-network-provider/conf/distro/network-provisioner.conf
```bitbake
include ../machine/${MACHINE}-extra.conf

DISTRO_NAME = "Network Provider"
DISTRO_VERSION = "0.1"

IMAGE_INSTALL_append = " dnsmasq "

EXTRA_IMAGE_FEATURES = " debug-tweaks ssh-server-openssh"
DISTRO_FEATURES_append = " systemd "
DISTRO_FEATURES_BACKFILL_CONSIDERED += "sysvinit"
VIRTUAL-RUNTIME_init_manager = "systemd"
VIRTUAL-RUNTIME_initscripts = "sytemd-compat-units"
PACKAGECONFIG_append_pn-systemd  = " systemd-networkd networkd resolved "

ENABLE_I2C = "1"
```

## layers/meta-network-provider/conf/layer.conf
```bitbake
BBPATH .= ":${LAYERDIR}"

# We have recipes-* directories, add to BBFILES
BBFILES += "${LAYERDIR}/recipes/**/*.bb \
            ${LAYERDIR}/images/*.bb \
            ${LAYERDIR}/recipes/**/*.bbappend"

BBFILE_COLLECTIONS += "meta-network-provider"
BBFILE_PATTERN_meta-network-provider = "^${LAYERDIR}/"
BBFILE_PRIORITY_meta-network-provider = "6"

LAYERDEPENDS_meta-network-provider = "core"
LAYERSERIES_COMPAT_meta-network-provider = "hardknott"
```
